## boards/getafix/Kconfig.dvt3
```kconfig
# SPDX-License-Identifier: Apache-2.0

config BOARD_GETAFIX_DVT3
    bool
    default y
    help
      Waveshare T5-E1 Touch AMOLED 1.75 using PebbleOS FreeRTOS.

config T5AI_CP_BLE_TRACE
    bool "Sample the matching vendor CP BLE connection state"
    default n
    help
      Diagnostic only. Requires the vendor CP ELF documented in the DVT3
      Bluetooth incident report; its SRAM ABI is not stable across CP builds.
      Retains eight seconds of read-only samples and logs them on disconnect.
```
