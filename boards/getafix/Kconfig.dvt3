## boards/unhygienix/Kconfig
```kconfig
# SPDX-FileCopyrightText: 2026 Barry Carter <barry.carter@gmail.com>
# SPDX-License-Identifier: Apache-2.0

config BOARD_UNHYGIENIX
    bool
    default y
    help
      Unhygienix (The village fishmonger).
      Waveshare T5-E1 Touch AMOLED 1.75 using the PebbleOS kernel.

config T5AI_SD_PFS
    bool "Use a disposable 32 MiB TF-card PFS (AP SDIO/DMA)"
    depends on BOARD_UNHYGIENIX && SERVICE_FILESYSTEM
    default n
    help
      Use a private card area instead of internal-flash PFS. Initializing an
      unrecognized volume overwrites that area. Requires a card at every boot;
      I/O failure asserts because the stock FTL cannot propagate errors.
      Four-bit SD uses GPIO10/11, disabling the direct AP UART0 path.
      Runtime logs continue through the CP mailbox on the onboard USB if02.
      No migration, live removal, or interrupted-sector-write recovery.

config T5AI_SD_4BIT
    bool "Use four SD data lines"
    depends on T5AI_SD_PFS
    default y
    help
      D2/D3 share GPIO10/11 with the programming UART. Runtime logs use
      the other onboard USB UART through the CP mailbox. Disable this
      option for one-bit DMA diagnostics and electrical-coexistence checks.

config T5AI_TASK_CPU_METRICS
    bool "Report task CPU counters every five seconds"
    depends on BOARD_UNHYGIENIX && !T5AI_BG_TRACE && !T5AI_APP_TRACE && !T5AI_BG_PICK_TRACE
    default n
    help
      Snapshot existing scheduler runtime counters without scheduler hooks or
      PC sampling. Report all tasks, including zero runtime, outside IRQ locks.
      Runtime includes interrupts charged to the interrupted task.

config T5AI_STATE_TRACE
    bool "Record T5AI app and background task state across reset"
    depends on BOARD_UNHYGIENIX
    default n
    help
      Optional diagnostic recorder; disabled in normal builds.
      Sample task scheduling state into a bounded RAM ring once per second.
      Print valid records on the next boot if RAM survives the reset.
      Adds a 1536-byte thread stack and an 848-byte retained ring.
      No stack or register tracing; does not change watchdog timing.

config T5AI_REMINDER_PROFILE
    bool "Measure pin/reminder rewrite phases and flash calls"
    depends on BOARD_UNHYGIENIX && !T5AI_BG_TRACE
    default n
    help
      Temporary timing diagnostics for pindb and reminderdb. No stack/register tracing.
      Reports phase wall/CPU times and synchronous flash call totals after DB unlock.
      Keeps shared source unchanged; disables LTO in intercepted translation units.

config T5AI_REBOOT_TRACE
    bool "Trace T5 CP heartbeat and AP reset lifecycle"
    depends on BOARD_UNHYGIENIX
    default n
    help
      Bounded RAM event ring and low-priority UART drain thread.
      Records heartbeat attempts, sends, acknowledgements and reset entry.
      No stack/register tracing or watchdog policy changes.
      Adds a 1536-byte stack, 776-byte retained ring and 776-byte replay buffer.

config T5AI_INTERRUPT_PROFILE
    bool "Measure T5 tick gaps, kernel interrupt masks and clock changes"
    depends on T5AI_REBOOT_TRACE
    default n
    help
      Temporary bounded counters, printed by the existing reboot trace worker.
      No stack or general-register tracing, logging in interrupt context,
      clock writes, task priority changes or tick compensation.
      Disables LTO on intercepted kernel files to preserve diagnostic hooks.

config T5AI_HEAP_TRACE
    bool "Trace bounded kernel allocation history and OOM callers"
    depends on T5AI_REBOOT_TRACE
    default n
    help
      Keep the last 16 kernel heap operations without allocation or logging.
      Existing reboot worker prints heap totals every ten seconds, and recent
      operations when low. Croak OOM dumps history before the existing handler.
      No stack walks, priority changes or allocator policy changes.

config T5AI_FAULT_TRACE
    bool "Capture minimal T5 HardFault evidence"
    depends on BOARD_UNHYGIENIX
    default n
    help
      Wrap only the fatal HardFault vector, preserving the stock handler.
      Send PC/LR, exception context, SCB fault status and active MPU regions
      through bounded emergency CP logs. Recover one original exception
      frame only at MemManage entry. No heap, task locks or stack dump.
      Adds a private 512-byte fault stack; delivery is best effort.

config T5AI_FLASH_PROFILE
    bool "Measure T5 flash IPC operation durations"
    depends on BOARD_UNHYGIENIX
    default n
    help
      Keep lock-free read/write/erase timing and active-operation samples.
      Disabled builds contain no sampling counters or timestamp reads.

config T5AI_DISPLAY_MEMORY_BENCH
    bool "Benchmark T5 display row memory at initialization"
    depends on BOARD_UNHYGIENIX
    default n
    help
      Compare linked libc and wide row operations over 1024 repetitions.
      Diagnostic only; reports elapsed AON ticks before display DMA starts.

config T5AI_DRAW_PROFILE
    bool "Buffer drawing function and scheduler timing until UI idle"
    depends on BOARD_UNHYGIENIX && !T5AI_APP_TRACE && !T5AI_BG_TRACE && !T5AI_INTERRUPT_PROFILE && !T5AI_TASK_CPU_METRICS
    default n
    help
      Instrument launcher/menu/text-node functions and window rendering only.
      Report bounded address-keyed inclusive wall/scheduled-time counters after
      two seconds without rendering. Scheduler time includes IRQ execution;
      it is not exclusive drawing CPU time. No PC sampling or per-frame logs.

config T5AI_DRAW_PROFILE_DETAIL
    bool "Time individual menu, glance and text-node functions"
    depends on T5AI_DRAW_PROFILE
    default n
    help
      Adds translation-unit function instrumentation and larger buffers.
      Measure its overhead against the default coarse recorder before using
      the detailed results to attribute normal-build drawing time.

config T5AI_DISPLAY_BATCH_ROWS
    int "Logical rows per T5 DMA staging batch"
    depends on BOARD_UNHYGIENIX
    range 1 3
    default 1
    help
      Two buffers each reserve up to two physical rows per logical row.
      Keep one for the established transport; compare two and three in
      separate hardware experiments before changing the default.

config T5AI_TOUCH_QUEUE_COALESCE
    bool "Coalesce queued builtin-app touch motion with acquisition timestamps"
    depends on BOARD_UNHYGIENIX
    default n
    help
      Experimental: keep the two newest consecutive queued motion samples.
      Never coalesce down/up, cross other event types or affect unprivileged apps.
      Pan velocity uses acquisition time rather than queue-drain time.

config T5AI_COMPOSITOR_FAST_PATH
    bool "Specialize native T5 compositor memory operations"
    depends on BOARD_UNHYGIENIX
    default n
    help
      Experimental full native assignment copies only intersecting row spans.
      Preserve the full clear and delegate legacy/scaled/overlay modes to stock.

config T5AI_TEXT_NODE_CACHE
    bool "Reuse repeated text-node measurements within one privileged App render"
    depends on BOARD_UNHYGIENIX
    default n
    help
      Experimental 16-entry bounded cache, reset every render. Match exact text,
      font, box, overflow, alignment, spacing and flow attributes. Only text-node
      measurement uses it; long text, other tasks and unprivileged apps stay stock.

config T5AI_DISPLAY_DMA_IRQ
    bool "Sleep for batched T5 display DMA completion"
    depends on BOARD_UNHYGIENIX && T5AI_DISPLAY_BATCH_ROWS >= 2
    default n
    help
      Experimental channel-zero completion on the shared secure GDMA IRQ.
      Keep microphone channel-one dispatch and the elapsed-time deadline.

config T5AI_DISPLAY_WORKER
    bool "Transport T5 display frames on a board-local worker"
    depends on BOARD_UNHYGIENIX
    default n
    help
      Experimental: snapshot borrowed row descriptors on the caller, retain
      framebuffer ownership until completion on KernelMain, and serialize
      physical display controls against transport. Adds a 2 KB worker stack
      and 2080 bytes of descriptors in reserved PSRAM; no full-frame copy.

config T5AI_IO_PROFILE
    bool "Buffer T5 touch, shared-bus and resource-read measurements"
    depends on T5AI_DRAW_PROFILE
    default n
    help
      Count callback queue/lock/bus waits, wire reads, immutable XIP copies,
      cache hits, CP reads, App queue age and coalesced moves. Emit only after
      physical gestures. Elapsed times include preemption; categories overlap.

config T5AI_IO_CPU_PROFILE
    bool "Snapshot T5 gesture CPU duty without periodic sampling"
    depends on T5AI_IO_PROFILE
    default n
    help
      Snapshot scheduler idle/App/Main runtime at first contact and last release,
      then report after the gesture. Includes time between contacts, excluding
      the final quiet-report delay. Thread runtime includes IRQ interference.

config T5AI_RESOURCE_WIDE_COPY
    bool "Use aligned word copying for immutable T5 resource reads"
    depends on BOARD_UNHYGIENIX
    default n
    help
      Experimental scoped copy after the existing immutable-bank range check.
      Preserve byte fallback/tails, CP ownership, leases, PFS and flash writes.

config T5AI_DISPLAY_ROTATED_DMA
    bool "Batch sorted rotated T5 rows with DMA"
    depends on BOARD_UNHYGIENIX
    default n
    help
      Experimental reverse traversal of borrowed row descriptors, retaining
      existing pixel reversal/scaling. Unsorted/duplicate/gapped rows retain
      their order using individual DMA windows. Uses 2080 bytes of reserved
      PSRAM, with no full-frame pixel copy.

config T5AI_DISPLAY_RECOVERY
    bool "Replay failed T5 DMA updates and retry bounded recovery"
    depends on BOARD_UNHYGIENIX && T5AI_DISPLAY_ROTATED_DMA
    default n
    help
      Experimental: preserve borrowed dirty row descriptors, stop DMA on error,
      retry a memory self-test and DMA repaint at most three times per boot,
      one second apart after the first attempt. Retain buffer ownership during
      retries. Persistent failure stops output and reports outside the lock;
      no CPU repaint is used. Reuses worker descriptors or reserves 2080 bytes
      of PSRAM otherwise.

config T5AI_DISPLAY_FAULT_TEST
    bool "Inject one completed-transfer failure for T5 recovery qualification"
    depends on T5AI_DISPLAY_RECOVERY
    default n
    help
      Diagnostic only. After eight seconds uptime, report one successfully
      completed DMA transfer as failed to exercise replay and recovery safely.

config T5AI_DISPLAY_PROFILE
    bool "Measure T5 display frame durations"
    depends on BOARD_UNHYGIENIX
    select PROFILER
    default n
    help
      Enable the stock render profiler and report all-frame timing windows,
      app/compositor phase totals and DMA failures every sixteen updates.
      Disabled builds contain no frame sampling or diagnostic logs.

config T5AI_HCI_PROFILE
    bool "Measure T5 HCI traffic and task state"
    depends on BOARD_UNHYGIENIX
    default n
    help
      Keep transport counters and print periodic heartbeat and disconnect
      snapshots. Disabled builds omit diagnostic counters and task sampling.

config T5AI_BG_PICK_TRACE
    bool "Count actual KernelBG scheduler selections without a trace worker"
    depends on BOARD_UNHYGIENIX && !T5AI_BG_TRACE && !T5AI_APP_TRACE
    default n
    help
      Count runnable KernelBG selections by competing priority and App identity.
      Report peak observed ready age and selector gaps from the AON RTC every
      five seconds using an existing timer task. No dedicated stack or ring.

config T5AI_WDT_RECOVERY_TRACE
    bool "Log priorities and flash activity at KernelBG watchdog expiry"
    select T5AI_FLASH_PROFILE
    depends on BOARD_UNHYGIENIX && !T5AI_WDT_CAUSE_TRACE && !T5AI_BG_TRACE && !T5AI_REMINDER_PROFILE
    default n
    help
      Snapshot App and KernelBG base/effective priorities, held mutex count,
      state and wait queue only when the watchdog invokes BG recovery.
      No periodic sampling or diagnostic task is added.

config T5AI_WDT_CAUSE_TRACE
    bool "Trace watchdog suspension and public feed callers"
    depends on T5AI_BG_PICK_TRACE
    default n
    help
      Record bounded suspend/resume events and last public feed callers with
      RTC, thread and BG callback context. Use the existing selector report
      timer, without allocating a diagnostic thread or changing watchdog policy.

config T5AI_BG_TRACE
    bool "Trace KernelBG scheduling and blocking"
    depends on BOARD_UNHYGIENIX
    default n
    help
      Record callback running, ready and blocked wall time using the AON RTC.
      Capture wait objects, mutex owner and caller without stack walks.
      Board-local compiler instrumentation and linker wrappers leave common
      source unchanged. A bounded worker drains records outside scheduler locks.

config T5AI_APP_TRACE
    bool "Sample App PCs and event processing during BG starvation"
    depends on BOARD_UNHYGIENIX && !T5AI_INTERRUPT_PROFILE
    select T5AI_BG_TRACE
    default n
    help
      Sample interrupted App thread PCs with jittered 7-13 ms intervals.
      Trace the exact App event queue and report processing spans over 100 ms.
      Bounded tables and the BG diagnostic worker keep logging outside ISRs.
      Samples exclude masked interrupts and handler execution.

config T5AI_ACCEL_DISABLED
    bool "Disable QMI8658 acquisition for diagnostic comparison"
    depends on BOARD_UNHYGIENIX && ACCEL_QMI8658_T5AI
    default n
    help
      Power down the QMI8658 during initialization and skip its worker and
      poll timer. Keep the stock accelerometer service and app APIs intact.
      No periodic I2C reads, shake detection or sample delivery occur.

config T5AI_SDK_COMPAT_CACHE
    bool "Cache immutable process SDK compatibility flags"
    depends on BOARD_UNHYGIENIX
    default y
    help
      Avoid repeated privilege transitions in software drawing by publishing
      App/Worker SDK flags in the existing unprivileged read-only data region.
      Flags are refreshed before process launch and invalidated after cleanup.
      Uses eight bytes, no allocation, locks or task-priority changes.

config T5AI_PIXEL_FAST_PATH
    bool "Use the T5AI software pixel plotting fast path"
    depends on BOARD_UNHYGIENIX && SCREEN_COLOR_DEPTH_BITS = 8
    default n
    help
      Combine clipping and bitmap row addressing for rectangular and circular
      8-bit destinations. Opaque pixels use direct stores and transparent
      pixels skip the destination read. Partial alpha uses stock blending.
      Uncommon formats and clip geometry retain the stock implementation.
      Opt-in pending broader watchface and connected-soak coverage.

config T5AI_QMI8658_PROFILE
    bool "Measure QMI8658 acquisition and delivery"
    depends on BOARD_UNHYGIENIX && ACCEL_QMI8658_T5AI
    default n
    help
      Bounded counters reported every five seconds. Worker CPU uses scheduler
      ticks; transfer wall time includes blocking and preemption. No per-byte
      tracing, priority changes or shared kernel instrumentation.

config T5AI_I2C_RX_FIFO
    bool "Batch T5AI I2C receive interrupts using the controller FIFO"
    depends on BOARD_UNHYGIENIX && I2C_T5AI
    default y
    help
      Experimental bounded 4/8/12-byte receive interrupts with a one-byte
      tail. Retain byte-driven writes, bus frequency and completion semantics.

config T5AI_I2C_PROFILE
    bool "Measure T5AI I2C interrupt entries and handler cycles"
    depends on T5AI_QMI8658_PROFILE
    default n
    help
      Count I2C entries, received bytes and DWT handler cycles. Report using
      the QMI five-second profile window without per-byte logging. Handler
      cycles include nested preemption; do not add to scheduler CPU totals.

config T5AI_I2C_RX_FIFO_LIMIT4
    bool "Limit experimental T5AI I2C receive bursts to four bytes"
    depends on T5AI_I2C_RX_FIFO
    default n
    help
      Compare shorter bounded ISR bursts against the twelve-byte maximum.
      Keep the same bus clock and single-byte tail policy.
```
