## fw/services/boot_splash/Kconfig
```kconfig
# SPDX-FileCopyrightText: 2026 Core Devices LLC
# SPDX-License-Identifier: Apache-2.0

config SERVICE_BOOT_SPLASH
    bool "Boot splash"
    help
      Boot splash screen service.

config BOOT_SPLASH_CUSTOM_PLATFORM
    bool
    help
      Platform supplies deferred startup and framebuffer allocation hooks.

config BOOT_SPLASH_ARGB2222
    bool
    default y if QEMU || SOC_POSIX
    help
      The display boot-frame interface accepts ARGB2222 rather than RGB332.
```

## fw/services/firmware_update/Kconfig
```kconfig
# SPDX-FileCopyrightText: 2026 Core Devices LLC
# SPDX-License-Identifier: Apache-2.0

config SERVICE_FIRMWARE_UPDATE
    bool "Firmware update"
    help
      Firmware update endpoint/state machine.

# Platform capabilities are separate from exposing the protocol services.
config FIRMWARE_UPDATE_SUPPORTED
    bool
    default y
    help
      The platform has a supported firmware install and restart flow.

config RECOVERY_UPDATE_SUPPORTED
    bool
    default y
    help
      The platform has a supported recovery image destination and install flow.

config SYSTEM_RESOURCE_UPDATE_SUPPORTED
    bool
    default y
    help
      The platform has a writable system-resource update bank and activation flow.

if SERVICE_FIRMWARE_UPDATE

module = SERVICE_FIRMWARE_UPDATE
module-str = Firmware update
source "subsys/logging/Kconfig.template.log_level"

endif
```

## soc/Kconfig
```kconfig
# SPDX-FileCopyrightText: 2026 Core Devices LLC
# SPDX-License-Identifier: Apache-2.0

choice
    prompt "SoC"
    help
      SoC family. Real boards pick a vendor SoC; QEMU boards pick
      SOC_QEMU and then choose the emulated core.

config SOC_NRF52
    bool "Nordic nRF52"
    select HAL_NORDIC
    select CPU_CORTEX_M4
    select CPU_HAS_FPU

config SOC_SF32LB52
    bool "SiFli SF32LB52"
    select HAL_SIFLI
    select CPU_STAR_MC1
    select CPU_HAS_FPU
    select RAMFUNC

config SOC_T5AI
    bool "Tuya T5AI / BK7258 application CPU"
    select RAMFUNC
    select CPU_CORTEX_M33
    select ARMV8_M_DSP
    select CPU_HAS_FPU

config T5AI_PFS_HEADER_CACHE
    bool "Cache T5AI PFS headers per page"
    depends on SOC_T5AI
    default y

config SOC_QEMU
    bool "QEMU emulated"

config SOC_POSIX
    bool "POSIX host"
    select ARCH_POSIX
    help
      Run the firmware as a native application on a POSIX host
      (Linux, macOS), with emulated peripherals.

endchoice

config SOC
    string
    default "NRF52" if SOC_NRF52
    default "SF32LB52" if SOC_SF32LB52
    help
      Stringified SoC name, for places that need the name as a token
      (e.g. sftool -c). Empty on QEMU and POSIX boards.

config SDL
    bool
    depends on SOC_POSIX
    help
      SDL, for the host halves of the drivers of a native build that
      need a window or its input. Selected by those drivers.

config QEMU
    bool
    default y if SOC_QEMU
    help
      Derived alias for SOC_QEMU. Gates features that don't make
      sense under emulation.

choice
    prompt "Emulated core"
    depends on SOC_QEMU

config SOC_QEMU_CORTEX_M4
    bool "Cortex-M4"
    select CPU_CORTEX_M4

config SOC_QEMU_CORTEX_M33
    bool "Cortex-M33"
    select CPU_CORTEX_M33

endchoice

config T5AI_CORE_CLOCK_HZ
    int
    default 120000000
    depends on SOC_T5AI
config T5AI_CP_HCI_VALIDATED
    bool "Use validated Tuya CP HCI transport"
    depends on SOC_T5AI
```

## soc/t5ai/Kconfig
```kconfig
# SPDX-FileCopyrightText: 2026 Barry Carter <barry.carter@gmail.com>
# SPDX-License-Identifier: Apache-2.0

if SOC_T5AI

config T5AI_PFS_HEADER_CACHE
    bool "Cache T5AI PFS headers per page"
    default y

config T5AI_CORE_CLOCK_HZ
    int
    default 120000000

config T5AI_CP_HCI_VALIDATED
    bool "Use validated Tuya CP HCI transport"

endif
```

## src/bluetooth-fw/Kconfig
```kconfig
# SPDX-FileCopyrightText: 2026 Core Devices LLC
# SPDX-License-Identifier: Apache-2.0

menu "Bluetooth"

config T5AI_CP_HCI_VALIDATED
    bool "Enable validated T5AI CP HCI transport"
    depends on SOC_T5AI
    help
      Allow the live NimBLE backend to use the T5AI communications processor.
      Keep this disabled until CP firmware startup, clocks, mailbox ownership,
      cache coherency, and recovery have been validated on the target board.

choice BT_FW
    prompt "Bluetooth backend"
    default BT_FW_STUB
    help
      Which Bluetooth backend implementation to build. The default is
      derived from the SoC (see each soc/<soc>/Kconfig.defconfig);
      the stub is the fallback when no SoC default applies.

config BT_FW_NIMBLE
    bool "NimBLE"
    depends on !SOC_T5AI || T5AI_CP_HCI_VALIDATED
    select HAL_SIFLI_IPC_QUEUE if SOC_SF32LB52
    select HAL_SIFLI_LCPU if SOC_SF32LB52

config BT_FW_QEMU
    bool "QEMU transport"

config BT_FW_STUB
    bool "Stub (no backend)"

endchoice

module = BT
module-str = Bluetooth
source "subsys/logging/Kconfig.template.log_level"

config GH3X2X_TUNING_SERVICE_ENABLED
    bool "GH3X2X tuning service"
    depends on HRM_GH3X2X
    help
      Build the GH3X2X heart-rate sensor tuning GATT service, used to
      tune the sensor over BLE. Off by default.

endmenu
```

## src/fw/drivers/gpio/Kconfig
```kconfig
# SPDX-FileCopyrightText: 2026 Core Devices LLC
# SPDX-License-Identifier: Apache-2.0

menuconfig GPIO
    bool "GPIO"
    help
      GPIO Drivers

if GPIO

config GPIO_NRF5
    bool "Nordic nRF5"
    default y if SOC_NRF52
    help
      Support for the Nordic nRF5 GPIO controller.

config GPIO_SF32LB
    bool "SiFli SF32LB"
    default y if SOC_SF32LB52
    select HAL_SIFLI_GPIO
    help
      Support for the SiFli SF32LB GPIO controller.

config GPIO_T5AI
    bool "T5AI GPIO"
    default y if SOC_T5AI
    help
      Support for the BK7258 AON GPIO controller used by T5AI.

config GPIO_QEMU
    bool "QEMU GPIO"
    default y if SOC_QEMU
    help
      Support for the QEMU GPIO peripheral.

endif # GPIO
```
